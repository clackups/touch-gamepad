## main/Kconfig.projbuild
```kconfig
menu "Touch Gamepad"

choice TOUCH_GAMEPAD_BOARD
    prompt "Board preset"
    default TOUCH_GAMEPAD_BOARD_GUITION
    help
        Select the target device preset.

    config TOUCH_GAMEPAD_BOARD_GUITION
        bool "Guition ESP32-S3-4848S040"

    config TOUCH_GAMEPAD_BOARD_WAVESHARE
        bool "Waveshare ESP32-S3-Touch-LCD-4"
endchoice

choice TOUCH_GAMEPAD_WAVESHARE_EXPANDER
    prompt "Waveshare I/O expander"
    depends on TOUCH_GAMEPAD_BOARD_WAVESHARE
    default TOUCH_GAMEPAD_WAVESHARE_EXPANDER_CH32V003
    help
        Select the I2C I/O expander populated on the Waveshare board that gates
        the ST7701 LCD reset, the GT911 touch reset and the backlight. Board
        revisions ship with either the Waveshare CH32V003 (address 0x24, custom
        firmware, has a PWM backlight register) or a Texas Instruments TCA9554
        (address 0x20, standard register map, backlight driven as a plain output).
        If the panel stays dark and both the expander and the GT911 time out on
        the I2C bus with the CH32V003 selected, try the TCA9554 option.

    config TOUCH_GAMEPAD_WAVESHARE_EXPANDER_CH32V003
        bool "CH32V003 (0x24)"

    config TOUCH_GAMEPAD_WAVESHARE_EXPANDER_TCA9554
        bool "TCA9554 (0x20)"
endchoice

config TOUCH_GAMEPAD_ENABLE_USB
    bool "Compile the USB HID gamepad backend"
    default y if TOUCH_GAMEPAD_BOARD_WAVESHARE
    default n
    help
        Enable the TinyUSB HID gamepad backend. Only boards that expose a USB
        device port (Waveshare ESP32-S3-Touch-LCD-4) can act as a USB gamepad.
        The Guition ESP32-S3-4848S040 has no exposed USB port and stays BLE only.

config TOUCH_GAMEPAD_SCREEN_WIDTH
    int "Display width"
    default 480

config TOUCH_GAMEPAD_SCREEN_HEIGHT
    int "Display height"
    default 480

config TOUCH_GAMEPAD_CORNER_MARGIN
    int "Corner tap margin"
    default 96
    help
        Tap distance in pixels from a screen edge that qualifies as a corner tap.

choice TOUCH_GAMEPAD_DEFAULT_TRANSPORT
    prompt "Default transport"
    default TOUCH_GAMEPAD_DEFAULT_TRANSPORT_BLE if TOUCH_GAMEPAD_BOARD_GUITION
    default TOUCH_GAMEPAD_DEFAULT_TRANSPORT_USB if TOUCH_GAMEPAD_BOARD_WAVESHARE

    config TOUCH_GAMEPAD_DEFAULT_TRANSPORT_BLE
        bool "BLE"

    config TOUCH_GAMEPAD_DEFAULT_TRANSPORT_USB
        bool "USB"
endchoice

choice TOUCH_GAMEPAD_DEFAULT_THEME
    prompt "Default theme"
    default TOUCH_GAMEPAD_DEFAULT_THEME_BLUE

    config TOUCH_GAMEPAD_DEFAULT_THEME_BLUE
        bool "Blue on black"

    config TOUCH_GAMEPAD_DEFAULT_THEME_GREEN
        bool "Green on black"
endchoice

endmenu
```

## sdkconfig.defaults
```kconfig
# Shared build defaults for the touch-gamepad firmware.
# Applied before the board-specific overlay. ASCII only. See AGENTS.md.

CONFIG_IDF_TARGET="esp32s3"

# 16 MB flash with a larger single-app partition for LVGL and Bluetooth.
CONFIG_ESPTOOLPY_FLASHSIZE_16MB=y
CONFIG_PARTITION_TABLE_SINGLE_APP_LARGE=y

# Octal PSRAM holds the RGB panel framebuffers.
CONFIG_SPIRAM=y
CONFIG_SPIRAM_MODE_OCT=y
CONFIG_SPIRAM_SPEED_80M=y

# 1 kHz tick keeps touch polling and LVGL animations smooth.
CONFIG_FREERTOS_HZ=1000

# Bluetooth LE via Bluedroid for the BLE HID gamepad backend.
CONFIG_BT_ENABLED=y
CONFIG_BT_BLUEDROID_ENABLED=y
CONFIG_BT_BLE_ENABLED=y
CONFIG_BT_GATTS_ENABLE=y
CONFIG_BT_CLASSIC_ENABLED=n

# The ESP32-S3 controller is BLE 5.0; the HID backend advertises through the
# extended advertising API, which requires the BLE 5.0 feature set.
CONFIG_BT_BLE_50_FEATURES_SUPPORTED=y

# LVGL color depth matches the RGB565 panel.
CONFIG_LV_COLOR_DEPTH_16=y
```

## sdkconfig.defaults.guition
```kconfig
# Guition ESP32-S3-4848S040 overlay (BLE only).
CONFIG_TOUCH_GAMEPAD_BOARD_GUITION=y
CONFIG_TOUCH_GAMEPAD_DEFAULT_TRANSPORT_BLE=y
CONFIG_TOUCH_GAMEPAD_ENABLE_USB=n
```

## sdkconfig.defaults.waveshare
```kconfig
# Waveshare ESP32-S3-Touch-LCD-4 overlay (BLE or USB).
CONFIG_TOUCH_GAMEPAD_BOARD_WAVESHARE=y
CONFIG_TOUCH_GAMEPAD_DEFAULT_TRANSPORT_USB=y
CONFIG_TOUCH_GAMEPAD_ENABLE_USB=y

# TinyUSB HID interface for the USB gamepad backend.
CONFIG_TINYUSB_HID_COUNT=1
```
